/**
 * Yahboom 8-channel black-line PID line follower for MSPM0G3507 LQFP-64.
 */
//@cliArgs --device "MSPM0G350X" --package "LQFP-64(PM)" --part "Default"
//@v2CliArgs --device "MSPM0G3507" --package "LQFP-64(PM)"
// @cliArgs --board /ti/boards/LP_MSPM0G3507 --rtos nortos

const GPIO   = scripting.addModule("/ti/driverlib/GPIO", {}, false);
const GPIO1  = GPIO.addInstance();
const GPIO2  = GPIO.addInstance();
const GPIO3  = GPIO.addInstance();
const GPIO4  = GPIO.addInstance();
const GPIO5  = GPIO.addInstance();
const GPIO6  = GPIO.addInstance();
const PWM    = scripting.addModule("/ti/driverlib/PWM", {}, false);
const PWM1   = PWM.addInstance();
const SYSCTL = scripting.addModule("/ti/driverlib/SYSCTL");

GPIO1.$name                         = "GPIO_LEDS";
GPIO1.port                          = "PORTB";
GPIO1.associatedPins.create(2);
GPIO1.associatedPins[0].$name       = "USER_LED_1";
GPIO1.associatedPins[0].assignedPin = "2";
GPIO1.associatedPins[1].$name       = "USER_LED_2";
GPIO1.associatedPins[1].assignedPin = "3";

/* Yahboom motor-driver software I2C. */
GPIO2.$name                              = "GPIO_I2C";
GPIO2.port                               = "PORTA";
GPIO2.associatedPins.create(2);
GPIO2.associatedPins[0].$name            = "SCL";
GPIO2.associatedPins[0].direction        = "INPUT";
GPIO2.associatedPins[0].internalResistor = "PULL_UP";
GPIO2.associatedPins[0].assignedPin      = "12";
GPIO2.associatedPins[1].$name            = "SDA";
GPIO2.associatedPins[1].direction        = "INPUT";
GPIO2.associatedPins[1].internalResistor = "PULL_UP";
GPIO2.associatedPins[1].assignedPin      = "13";

/* User-confirmed grayscale wiring. */
GPIO3.$name                           = "GPIO_GRAY8";
GPIO3.port                            = "PORTA";
GPIO3.associatedPins.create(4);
GPIO3.associatedPins[0].$name         = "OUT";
GPIO3.associatedPins[0].direction     = "INPUT";
GPIO3.associatedPins[0].assignedPin   = "14";
GPIO3.associatedPins[1].$name         = "AD0";
GPIO3.associatedPins[1].direction     = "OUTPUT";
GPIO3.associatedPins[1].initialValue  = "CLEARED";
GPIO3.associatedPins[1].assignedPin   = "15";
GPIO3.associatedPins[2].$name         = "AD1";
GPIO3.associatedPins[2].direction     = "OUTPUT";
GPIO3.associatedPins[2].initialValue  = "CLEARED";
GPIO3.associatedPins[2].assignedPin   = "16";
GPIO3.associatedPins[3].$name         = "AD2";
GPIO3.associatedPins[3].direction     = "OUTPUT";
GPIO3.associatedPins[3].initialValue  = "CLEARED";
GPIO3.associatedPins[3].assignedPin   = "17";

/* MPU6050 software I2C. AD0 is wired to GND, so the address is 0x68. */
GPIO4.$name                          = "MPU6050";
GPIO4.port                           = "PORTA";
GPIO4.associatedPins.create(2);
GPIO4.associatedPins[0].$name        = "IMU_SCL";
GPIO4.associatedPins[0].initialValue = "SET";
GPIO4.associatedPins[0].ioStructure  = "OD";
GPIO4.associatedPins[0].assignedPin  = "1";
GPIO4.associatedPins[1].$name        = "IMU_SDA";
GPIO4.associatedPins[1].initialValue = "SET";
GPIO4.associatedPins[1].ioStructure  = "OD";
GPIO4.associatedPins[1].assignedPin  = "0";

/* Expansion-board buttons are active low and use internal pull-ups. */
GPIO5.$name                              = "BUTTONS_A";
GPIO5.port                               = "PORTA";
GPIO5.associatedPins.create(2);
GPIO5.associatedPins[0].$name            = "K1";
GPIO5.associatedPins[0].direction        = "INPUT";
GPIO5.associatedPins[0].internalResistor = "PULL_UP";
GPIO5.associatedPins[0].assignedPin      = "2";
GPIO5.associatedPins[1].$name            = "K4";
GPIO5.associatedPins[1].direction        = "INPUT";
GPIO5.associatedPins[1].internalResistor = "PULL_UP";
GPIO5.associatedPins[1].assignedPin      = "23";

GPIO6.$name                              = "BUTTONS_B";
GPIO6.port                               = "PORTB";
GPIO6.associatedPins.create(2);
GPIO6.associatedPins[0].$name            = "K2";
GPIO6.associatedPins[0].direction        = "INPUT";
GPIO6.associatedPins[0].internalResistor = "PULL_UP";
GPIO6.associatedPins[0].assignedPin      = "19";
GPIO6.associatedPins[1].$name            = "K3";
GPIO6.associatedPins[1].direction        = "INPUT";
GPIO6.associatedPins[1].internalResistor = "PULL_UP";
GPIO6.associatedPins[1].assignedPin      = "20";

/* Yahboom expansion-board buzzer: PB24 -> TIMA0 CCP3. */
PWM1.$name                      = "BUZZER";
PWM1.clockPrescale              = 256;
PWM1.timerCount                 = 99;
PWM1.ccIndex                    = [3];
PWM1.pwmMode                    = "EDGE_ALIGN_UP";
PWM1.peripheral.$assign         = "TIMA0";
PWM1.peripheral.ccp3Pin.$assign = "PB24";
PWM1.PWM_CHANNEL_3.$name        = "GPIO_BUZZER";
PWM1.PWM_CHANNEL_3.dutyCycle    = 0;

const Board = scripting.addModule("/ti/driverlib/Board", {}, false);

SYSCTL.forceDefaultClkConfig = true;
SYSCTL.clockTreeEn           = true;
